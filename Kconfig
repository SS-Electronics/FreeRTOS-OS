## Kconfig
```kconfig
# File:        Makefile
# Author:      Subhajit Roy  
#              subhajitroy005@gmail.com 
#
# Moudle:      Configuration of Kernel and Application
#
# This file is part of FreeRTOS-OS Project.
# 
# FreeRTOS-OS is free software: you can redistribute it and/or 
# modify it under the terms of the GNU General Public License 
# as published by the Free Software Foundation, either version 
# 3 of the License, or (at your option) any later version.
#
# FreeRTOS-OS is distributed in the hope that it will be useful,
# but WITHOUT ANY WARRANTY; without even the implied warranty of 
# MERCHANTABILITY or FITNESS FOR A PARTICULAR PURPOSE. See the 
# GNU General Public License for more details.
#
# You should have received a copy of the GNU General Public License 
# along with FreeRTOS-KERNEL. If not, see <https://www.gnu.org/licenses/>.


source "arch/Kconfig"

# config ARCH_ARM_CORTEX_M4
#     string "ARM Cortex-M4"
#     default y
#     help
#       Thhis options need to be provide 

# config ARCH_ARM_CORTEX_M7
#     int "ARM Cortex-M7"
#     default n
```

## arch/Kconfig
```kconfig
# File:        arch/Kconfig
# Author:      Subhajit Roy (subhajitroy005@gmail.com)
# Module:      Architecture / MCU configuration
#
# This file is part of FreeRTOS-OS Project.
# FreeRTOS-OS is free software; see <https://www.gnu.org/licenses/>.
#
# Structure mirrors STM32CubeMX:
#   1. MCU / Core selection
#   2. Clock tree configuration
#   3. Peripheral module enable/disable
#   4. System tuning (VDD, cache, tick priority)
#
# Pre-filled defaults target STM32F411VET6:
#   - ARM Cortex-M4F @ up to 100 MHz
#   - 512 KB Flash / 128 KB RAM
#   - 25 MHz HSE (common on VET6 breakout boards)
#   - No CAN, No DAC, No FMC, No ETH, No SAI, No DMA2D on this die.


# ─────────────────────────────────────────────────────────────────────────────
# MCU Selection
# ─────────────────────────────────────────────────────────────────────────────

config TARGET_MCU
    string "Target MCU part number"
    default "STM32F411xE"
    help
      The HAL symbol passed to the STM32 HAL layer.
      Examples: STM32F411xE, STM32H723xx, STM32U575xx.
      This must match the CMSIS device header guard symbol.
      F4 variants: STM32F411xE, STM32F405xx, STM32F429xx.
      H7 variants: STM32H723xx, STM32H733xx, STM32H743xx.
      U5 variants: STM32U575xx, STM32U585xx (Cortex-M33 + TrustZone).

config CPU_ARCH
    string "CPU architecture"
    default "ARM-CM4F"
    help
      Used to select the correct FreeRTOS portable layer.
      STM32F4xx → ARM-CM4F  (hard-float ABI, fpv4-sp-d16).
      STM32H7xx → ARM-CM7   (hard-float ABI, fpv5-d16).
      STM32U5xx → ARM-CM33  (hard-float ABI, fpv5-sp-d16, TrustZone-capable).


# ─────────────────────────────────────────────────────────────────────────────
# Clock Tree  (mirrors CubeMX RCC page)
# ─────────────────────────────────────────────────────────────────────────────

menu "Clock Configuration"

config HSE_VALUE
    int "External high-speed oscillator — HSE (Hz)"
    default 25000000
    help
      Frequency of the crystal/oscillator connected to OSC_IN/OSC_OUT.
      Nucleo-F411RE = 8 000 000 Hz.
      Most standalone STM32F411VET6 breakout boards = 25 000 000 Hz.

config HSE_STARTUP_TIMEOUT
    int "HSE startup timeout (ms)"
    default 100

config HSI_VALUE
    int "Internal high-speed oscillator — HSI (Hz)"
    default 16000000
    help
      Fixed silicon oscillator; do not change unless you have a
      trimmed part with a different calibration.

config LSI_VALUE
    int "Internal low-speed oscillator — LSI (Hz)"
    default 32000

config LSE_VALUE
    int "External low-speed oscillator — LSE (Hz)"
    default 32768
    help
      32.768 kHz watch crystal for RTC / IWDG.

config LSE_STARTUP_TIMEOUT
    int "LSE startup timeout (ms)"
    default 5000

config EXTERNAL_CLOCK_VALUE
    int "External audio clock — I2S CKIN (Hz)"
    default 12288000
    help
      Only relevant when I2S is clocked from an external source
      (I2S_CKIN pin). Unused on most boards.

endmenu


# ─────────────────────────────────────────────────────────────────────────────
# STM32H7 Communication Peripherals
# Extra peripherals present on H723 but absent on F411.
# Leave all at n for F411 targets; enable selectively for H7 targets.
# ─────────────────────────────────────────────────────────────────────────────

menu "STM32H7 Peripherals (H723 / H7xx only)"

config HAL_FDCAN_MODULE_ENABLED
    bool "FDCAN (Flexible Data-rate CAN)"
    default n
    help
      STM32H723 has two FDCAN controllers. Enable when using CAN bus.

config HAL_DAC_MODULE_ENABLED
    bool "DAC (2-channel 12-bit)"
    default n

config HAL_ETH_MODULE_ENABLED
    bool "Ethernet MAC (ETH) — requires external PHY"
    default n

config HAL_MDMA_MODULE_ENABLED
    bool "Master DMA (MDMA) — cross-domain transfers"
    default n

config HAL_LPTIM_MODULE_ENABLED
    bool "Low-power timer (LPTIM1..5)"
    default n

config HAL_CRYP_MODULE_ENABLED
    bool "Cryptography accelerator (AES/DES/TDES)"
    default n

config HAL_HASH_MODULE_ENABLED
    bool "Hash processor (HASH)"
    default n

config HAL_OSPI_MODULE_ENABLED
    bool "OctoSPI (OSPI1/2) — external Flash / PSRAM"
    default n

config HAL_SDMMC_MODULE_ENABLED
    bool "SDMMC (SD/eMMC controller)"
    default n

endmenu


# ─────────────────────────────────────────────────────────────────────────────
# STM32U5 — Cortex-M33 + TrustZone specific options
# Only meaningful when CONFIG_TARGET_MCU = STM32U5xx variant.
# ─────────────────────────────────────────────────────────────────────────────

menu "STM32U5 / Cortex-M33 (U575 / U5xx only)"

config U5_TRUSTZONE_ENABLED
    bool "Enable TrustZone secure/non-secure split"
    default n
    help
      When set, the application builds against TZ-aware HAL symbols and
      the trustcore module configures the SAU (Security Attribution Unit)
      and GTZC (Global TrustZone Controller) during Reset_Handler.
      Default n — the example board ships as a single-image non-secure
      build; the trustcore module still runs for device-identity and
      flash-integrity attestation but does not partition the address map.

config HAL_GTZC_MODULE_ENABLED
    bool "GTZC — Global TrustZone Controller"
    default n
    help
      U5-only. Enables HAL_GTZC_* APIs that configure peripheral and
      memory-region secure attributions. Requires CONFIG_U5_TRUSTZONE_ENABLED.

config HAL_ICACHE_MODULE_ENABLED
    bool "ICACHE — Instruction cache"
    default n
    help
      U5-only. STM32U5 ships a dedicated ICACHE peripheral (separate from
      the Cortex-M33 core, which has no built-in cache). Enable to use
      HAL_ICACHE_Enable() once the system clock is up.

config HAL_PKA_MODULE_ENABLED
    bool "PKA — Public Key Accelerator"
    default n
    help
      U5-only. Used by the trustcore attestation path (ECDSA P-256 etc.).

endmenu


# ─────────────────────────────────────────────────────────────────────────────
# Core / Essential Modules  (always enabled on STM32F411)
# ─────────────────────────────────────────────────────────────────────────────

menu "Core Modules"

config HAL_CORTEX_MODULE_ENABLED
    bool "Cortex-M core module (SysTick, MPU, FPU)"
    default y

config HAL_PWR_MODULE_ENABLED
    bool "Power controller (PWR)"
    default y

config HAL_RCC_MODULE_ENABLED
    bool "Reset and clock control (RCC)"
    default y

config HAL_GPIO_MODULE_ENABLED
    bool "GPIO driver"
    default y

config HAL_EXTI_MODULE_ENABLED
    bool "External interrupt / event controller (EXTI)"
    default y

config HAL_FLASH_MODULE_ENABLED
    bool "Flash memory interface"
    default y

config HAL_DMA_MODULE_ENABLED
    bool "DMA controller (DMA1 / DMA2)"
    default y

config HAL_IWDG_MODULE_ENABLED
    bool "Independent watchdog (IWDG)"
    default n

config HAL_WWDG_MODULE_ENABLED
    bool "Window watchdog (WWDG)"
    default n

config HAL_CRC_MODULE_ENABLED
    bool "CRC calculation unit"
    default n

endmenu


# ─────────────────────────────────────────────────────────────────────────────
# Communication Peripherals
# Note: CAN, ETH, FMPI2C, FMPSMBUS are NOT present on STM32F411.
# ─────────────────────────────────────────────────────────────────────────────

menu "Communication Peripherals"

config HAL_UART_MODULE_ENABLED
    bool "UART (asynchronous mode)"
    default y
    help
      STM32F411VET6 has USART1, USART2, USART6.

config HAL_USART_MODULE_ENABLED
    bool "USART (synchronous mode)"
    default n

config HAL_SPI_MODULE_ENABLED
    bool "SPI (SPI1..SPI5)"
    default y
    help
      STM32F411VET6 has up to 5 SPI/I2S peripherals.

config HAL_I2C_MODULE_ENABLED
    bool "I2C (I2C1..I2C3)"
    default y

config HAL_I2S_MODULE_ENABLED
    bool "I2S audio interface"
    default n

config HAL_IRDA_MODULE_ENABLED
    bool "IrDA (via USART)"
    default n

config HAL_SMARTCARD_MODULE_ENABLED
    bool "Smart Card (via USART)"
    default n

config HAL_SMBUS_MODULE_ENABLED
    bool "SMBus (via I2C)"
    default n

endmenu


# ─────────────────────────────────────────────────────────────────────────────
# Timer Peripherals
# STM32F411: TIM1 (adv), TIM2..TIM5 (GP), TIM9..TIM11 (GP/basic)
# ─────────────────────────────────────────────────────────────────────────────

menu "Timer Peripherals"

config HAL_TIM_MODULE_ENABLED
    bool "Timer module (TIM1..TIM11)"
    default y

endmenu


# ─────────────────────────────────────────────────────────────────────────────
# Analog Peripherals
# Note: STM32F411 has ADC1 but NO DAC.
# ─────────────────────────────────────────────────────────────────────────────

menu "Analog Peripherals"

config HAL_ADC_MODULE_ENABLED
    bool "ADC (ADC1)"
    default n

endmenu


# ─────────────────────────────────────────────────────────────────────────────
# USB  (USB OTG FS on STM32F411 can be device or host)
# ─────────────────────────────────────────────────────────────────────────────

menu "USB"

config HAL_PCD_MODULE_ENABLED
    bool "USB device (PCD — Peripheral Controller Driver)"
    default n

config HAL_HCD_MODULE_ENABLED
    bool "USB host (HCD — Host Controller Driver)"
    default n

endmenu


# ─────────────────────────────────────────────────────────────────────────────
# Storage
# Note: STM32F411 has SDIO but NO FMC (no SDRAM / NOR / NAND / PCCARD).
# ─────────────────────────────────────────────────────────────────────────────

menu "Storage"

config HAL_SD_MODULE_ENABLED
    bool "SDIO / SD card"
    default n

endmenu


# ─────────────────────────────────────────────────────────────────────────────
# RTC and Security
# Note: STM32F411 has no HASH/CRYP hardware.
# ─────────────────────────────────────────────────────────────────────────────

menu "RTC and Security"

config HAL_RTC_MODULE_ENABLED
    bool "Real-time clock (RTC)"
    default n

config HAL_RNG_MODULE_ENABLED
    bool "Random number generator (RNG)"
    default n

endmenu


# ─────────────────────────────────────────────────────────────────────────────
# System Configuration  (mirrors CubeMX -> System Core -> SYS page)
# ─────────────────────────────────────────────────────────────────────────────

menu "System Configuration"

config VDD_VALUE
    int "VDD supply voltage (mV)"
    default 3300
    help
      Board supply voltage in millivolts. Most dev boards = 3300.
      Used by HAL for internal calculations.

config TICK_INT_PRIORITY
    int "SysTick / HAL tick interrupt priority"
    default 1
    help
      Must be >= configLIBRARY_MAX_SYSCALL_INTERRUPT_PRIORITY so that
      HAL_Delay() works correctly inside FreeRTOS tasks.

config PREFETCH_ENABLE
    bool "Enable Flash prefetch buffer"
    default y

config INSTRUCTION_CACHE_ENABLE
    bool "Enable instruction cache (ART accelerator)"
    default y

config DATA_CACHE_ENABLE
    bool "Enable data cache (ART accelerator)"
    default y

config USE_FULL_ASSERT
    bool "Enable HAL assert_param() parameter checks"
    default n
    help
      When enabled, every HAL function validates its parameters.
      Useful during development; disable for production to save code size.

endmenu
```
